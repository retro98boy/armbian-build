// SPDX-License-Identifier: (GPL-2.0+ OR MIT)
/dts-v1/;

#include "amlogic-t7-a311d2-corelab-tvpro.dtsi"

/ {
	memory@0 {
		device_type = "memory";
		reg = <0x0 0x0 0x0 0xe0000000
		       0x1 0x0 0x0 0xe0000000
		       0x2 0x0 0x0 0x40000000>;
	};
};
