// SPDX-License-Identifier: (GPL-2.0+ OR MIT)
/*
 * Copyright (c) 2026 retro98boy <retro98boy@qq.com>
 */

/dts-v1/;

#define ELO_TYPEC_NODE usb-typec@4e
#include "rk3588s-elo-backpack5.dts"

/ {
	model = "Elo Backpack5 EVT";
};

&usbc0 {
	compatible = "hynetek,husb311";
	reg = <0x4e>;
};
