// SPDX-License-Identifier: (GPL-2.0+ OR MIT)
/*
 * Copyright (c) 2026 retro98boy <retro98boy@qq.com>
 */

/dts-v1/;

#include "rk3588s-elo-backpack5.dts"

&usbc0 {
	compatible = "hynetek,husb311";
	reg = <0x4e>;
};
